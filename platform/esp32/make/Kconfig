## platform/esp32/make/Kconfig
```kconfig
mainmenu "OpenAMS display: what to build"

# The menu of `make menuconfig`, or `python make.py menuconfig` (make.py).
# These are the build options the -D flags of idf.py set; ESP-IDF's own
# settings stay in `make idf-menuconfig`. The choices are kept in make/config.

choice BOARD
    prompt "Display board"
    default BOARD_E32R40T
    help
        The board picks the chip, its ESP-IDF settings, its partition table
        and the UI's resolution (docs/guide/hardware.md). Each board builds in
        its own directory, build-<board>.

    config BOARD_E32R40T
        bool "4 inch E32R40T (ESP32, 480x320 SPI panel, resistive touch)"
    config BOARD_ES3C50P
        bool "5 inch ES3C50P (ESP32-S3, 800x480 RGB panel, capacitive touch)"
    config BOARD_ES3C43P
        bool "4.3 inch ES3C43P (ESP32-S3, 800x480 RGB panel, capacitive touch)"
endchoice

config TAG_WRITER
    bool "Spool tag writer"
    default y
    help
        Menu -> Tag writer: writes, reads, resets and clones filament tags with
        a reader wired to the board (docs/guide/tag-writer.md). An image with
        it is GPLv3; without it, the display alone is MIT. On the 4 inch board
        an image with it has no second OTA slot, so it is updated over USB.

choice TAG_READER
    prompt "Tag reader"
    depends on TAG_WRITER
    default TAG_READER_PN5180

    config TAG_READER_PN5180
        bool "PN5180 (every tag type and format)"
    config TAG_READER_MFRC522
        bool "MFRC522 (Bambu MIFARE Classic tags only)"
endchoice

choice TAG_LIBRARY_SOURCE
    prompt "Tag library"
    depends on TAG_WRITER
    default TAG_LIBRARY_OPENAMS
    help
        Where the genuine Bambu tags to clone from the touchscreen come from.

    config TAG_LIBRARY_OPENAMS
        bool "From OpenAMS on the printer host"
        help
            OpenAMS serves the Bambu-Lab-RFID-Library from the printer host
            (its openams_taglib Moonraker component, which downloads it on
            first use) to the display, over the printer link. Nothing is
            stored on the board.
    config TAG_LIBRARY_BOARD
        bool "On the board (5 and 4.3 inch only)"
        depends on BOARD_ES3C50P || BOARD_ES3C43P
        help
            The library lives in the board's own flash, so it works without
            the printer. It is filled over USB (make libflash, or the option
            below).
endchoice

config TAG_LIBRARY
    bool "Write the Bambu Lab tag library with make flash"
    depends on TAG_LIBRARY_BOARD
    default n
    help
        make flash also writes the Bambu-Lab-RFID-Library
        (github.com/queengooborg/Bambu-Lab-RFID-Library) into the board's tag
        library, every tag of it. It replaces what the library held. make
        clones the library the first time (about 200 MB) and writes it only
        when it changed since the last flash; make libupdate pulls the newest
        tags, make libflash writes it anyway.

config TAG_LIBRARY_DIR
    string "Where the library is (cloned there if it is not)"
    depends on TAG_LIBRARY_BOARD
    default "../../third_party/Bambu-Lab-RFID-Library"
    help
        A Bambu-Lab-RFID-Library checkout: a path from platform/esp32, an
        absolute path or ~/... The default is in the repository's
        third_party/, which git ignores.

choice LANGUAGES
    prompt "Languages"
    default LANGUAGES_LATIN
    help
        The languages the image carries. English is always one of them: it is
        the fallback for anything a translation leaves out.

    config LANGUAGES_LATIN
        bool "Latin and Cyrillic: en de es fr it pl pt-BR ru"
    config LANGUAGES_JA
        bool "Japanese and English"
    config LANGUAGES_KO
        bool "Korean and English"
    config LANGUAGES_ZH_HANS
        bool "Simplified Chinese and English"
    config LANGUAGES_ALL
        bool "Every language (5 and 4.3 inch boards only)"
        depends on BOARD_ES3C50P || BOARD_ES3C43P
        help
            Every language's strings and fonts: too large for the 4 inch
            board's app partition.
    config LANGUAGES_CUSTOM
        bool "A list of your own"
endchoice

config LANGUAGES_LIST
    string "Language codes, separated by ';'"
    depends on LANGUAGES_CUSTOM
    default "en;ja"
    help
        Codes from design/strings, for example "de;fr" or "ja;ko".

config PORT
    string "Serial port"
    default "/dev/ttyUSB0"
    help
        Where flash, monitor and libflash find the board: /dev/ttyUSB0 on
        Linux, COM3 on Windows. Empty lets idf.py look for it, and so does
        this default on Windows. PORT=... on the command line overrides it.
```
